## config/boards/shields/SeaSide44/Kconfig.defconfig
```kconfig
if SHIELD_SeaSide44_R

config ZMK_KEYBOARD_NAME
    default "SeaSide44_R"

config ZMK_SPLIT
    default y

config ZMK_SPLIT_ROLE_CENTRAL
    default y

endif

if SHIELD_SeaSide44_L

config ZMK_KEYBOARD_NAME
    default "SeaSide44_L"

config ZMK_SPLIT
    default y

endif
```

## config/boards/shields/SeaSide44/Kconfig.shield
```kconfig
config SHIELD_SeaSide44_R
    def_bool $(shields_list_contains,SeaSide44_R)

config SHIELD_SeaSide44_L
    def_bool $(shields_list_contains,SeaSide44_L)
```

## config/west.yml
```yaml
manifest:
  remotes:
    - name: zmkfirmware
      url-base: https://github.com/zmkfirmware
    - name: badjeff
      url-base: https://github.com/badjeff
    - name: caksoylar
      url-base: https://github.com/caksoylar
  projects:
    - name: zmk
      remote: zmkfirmware
      revision: v0.3
      import: app/west.yml
    - name: zmk-pmw3610-driver
      remote: badjeff
      revision: zmk-0.3
    - name: zmk-rgbled-widget
      remote: caksoylar
      revision: a3510c9de46de8b42c803286f4978466c6ea3916
  self:
    path: config
```
